/*******************************************************************************************************************************
 * Project : ESP-C3
 * Module  : ESP-C3\main
 * File    : gpio_init.c
 * Date    : 2026-10-11
 * Author  : LJD(291483914@qq.com)
 * Desc    : 板载通用 GPIO 初始化及电源辅助控制实现
 * -------------------------------------------------------
 * todo    :
 * 1. none
 * -------------------------------------------------------
 * Copyright (c) 2026 -inc
 *******************************************************************************************************************************/

//****************************************************Includes******************************************************************//
#include "gpio_init.h"

#include "Sys/sys_task.h"
#include "timer_task.h"
#include "Print/print_task.h"

#if (1)
//****************************************************Macros********************************************************************//

//****************************************************Parameter Initialization**************************************************//

//****************************************************Function Declaration******************************************************//

/***********************************************************************************************************************
 * 函数功能    : 板载通用 IO 口初始化
 * 说明(备注)  : 初始化辅助开机控制管脚为推挽输出并默认拉低
 * 传入参数    : 无
 * 输出参数    : 无
 * 返回值      : 无
 ************************************************************************************************************************/
void vGPIO_Init(void)
{
	gpio_config_t io_conf = {
		.pin_bit_mask = (1ULL << gpioASSIST_OPEN_PIN),
		.mode         = GPIO_MODE_OUTPUT,
		.pull_up_en   = 0,
		.pull_down_en = 0,
		.intr_type    = GPIO_INTR_DISABLE,
	};

	gpio_config(&io_conf);
	gpioASSIST_OPEN_OFF();
}

/***********************************************************************************************************************
 * 函数功能    : 协助 BMS 开启控制
 * 说明(备注)  : 输出开机脉冲拉高辅助管脚并重置 2S 定时器，超时后自动拉低
 * 传入参数    : en: true 开启辅助脉冲, false 结束辅助脉冲
 * 输出参数    : 无
 * 返回值      : bool: true 操作成功, false 失败
 ************************************************************************************************************************/
bool vGPIO_AssistBmsOpen(bool en)
{
	if (en == true)
	{
		tSysInfo.uInit.tFinish.bIF_Gpio = 0;  /* 关闭初始化, 预防按键误触发 */
		gpioASSIST_OPEN_ON();

		#if (boardBMS_EN)
		xTimerReset(tWakeUpBmsTimer, 0);      /* 开启软件定时, 2S后关闭 */
		#endif  /* boardBMS_EN */

		if (uPrint.tFlag.bSysTask)
		{
			sMyPrint("BMS电源辅助开启打开\r\n");
		}

		return true;
	}
	else
	{
		tSysInfo.uInit.tFinish.bIF_Gpio = 1;  /* 初始化完成 */
		gpioASSIST_OPEN_OFF();

		if (uPrint.tFlag.bSysTask)
		{
			sMyPrint("定时2S到达,关闭BMS辅助开启\r\n");
		}

		return true;
	}
}

#if (boardLOW_POWER)
/***********************************************************************************************************************
 * 函数功能    : IO 口进入低功耗模式
 * 说明(备注)  : 配置未用引脚为模拟输入以降低待机漏电流
 * 传入参数    : 无
 * 输出参数    : 无
 * 返回值      : 无
 ************************************************************************************************************************/
void vGPIO_EnterLowPower(void)
{
}

/***********************************************************************************************************************
 * 函数功能    : IO 口退出低功耗模式
 * 说明(备注)  : 重新初始化通用 GPIO 为正常运行状态
 * 传入参数    : 无
 * 输出参数    : 无
 * 返回值      : 无
 ************************************************************************************************************************/
void vGPIO_ExitLowPower(void)
{
	vGPIO_Init();
}
#endif  /* boardLOW_POWER */

#endif  /* 1 */
