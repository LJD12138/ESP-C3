/*******************************************************************************************************************************
 * Project : ESP-C3
 * Module  : ESP-C3\Hardware\BSP
 * File    : bsp_es8311.c
 * Date    : 2026-10-10
 * Author  : LJD(291483914@qq.com)
 * Desc    : ES8311 音频编解码器驱动
 * -------------------------------------------------------
 * todo    :
 * 1. none
 * -------------------------------------------------------
 * Copyright (c) 2026 -inc
 *******************************************************************************************************************************/

//****************************************************Includes******************************************************************//
#include "BSP/bsp_es8311.h"
#include "Print/print_task.h"

#if (1)

//****************************************************Parameter Initialization**************************************************//

static struct
{
	bool				bInited;			//是否初始化
	es8311_handle_t		hDev;				//设备句柄
	Es8311_ClockConfig_T	tClkCfg;		//时钟配置
	Es8311_Resolution_E	eResIn;				//输入分辨率
	Es8311_Resolution_E	eResOut;			//输出分辨率
	DevState_E			eDevState;			//设备状态
	bool				bMuteEn;			//静音使能
}tEs8311;

//****************************************************Function Declaration******************************************************//
/***********************************************************************************************************************
 * 函数功能    : 接口初始化
 * 说明(备注)  : 初始化默认配置
 * 传入参数    : none
 * 输出参数    : none
 * 返回值      : none
 ************************************************************************************************************************/
void vEs8311_IfaceInit(void)
{
    // 默认时钟配置
    tEs8311.tClkCfg.mclk_inverted = false;
    tEs8311.tClkCfg.sclk_inverted = false;
    tEs8311.tClkCfg.mclk_from_mclk_pin = false;  // 从SCLK引脚获取MCLK
    tEs8311.tClkCfg.mclk_frequency = 0;          // 不使用MCLK引脚
    tEs8311.tClkCfg.sample_frequency = 48000;    // 48kHz采样率

    // 默认分辨率
    tEs8311.eResIn = ES8311_RESOLUTION_16;
    tEs8311.eResOut = ES8311_RESOLUTION_16;

    tEs8311.eDevState = DS_INIT;
    tEs8311.bMuteEn = false;
}

/***********************************************************************************************************************
 * 函数功能    : 获取ES8311初始化状态
 * 说明(备注)  : 查询编解码芯片是否已成功初始化
 * 传入参数    : none
 * 输出参数    : none
 * 返回值      : true:已初始化  false:未初始化
 ************************************************************************************************************************/
bool bEs8311_IsIfaceInited(void)
{
    return tEs8311.bInited;
}

/***********************************************************************************************************************
 * 函数功能    : 初始化
 * 说明(备注)  : 创建句柄并初始化编解码器
 * 传入参数    : none
 * 输出参数    : none
 * 返回值      : 小于0:失败   大于0:成功
 ************************************************************************************************************************/
s8 cEs8311_Init(void)
{
    esp_err_t e_ret;

    tEs8311.bInited = false;

    // 接口初始化
    vEs8311_IfaceInit();

    // 创建ES8311设备句柄 (板级共享: IO0_I2C_SDA, IO1_I2C_SCL, I2C_NUM_0)
    if (tEs8311.hDev == NULL)
    {
        tEs8311.hDev = es8311_create(I2C_NUM_0, ES8311_I2C_ADDR);
        if (tEs8311.hDev == NULL)
        {
            if (uPrint.tFlag.bImportant)
                log_e("bsp_es8311: Create handle failed");

            tEs8311.eDevState = DS_LOST;
            return -1;
        }
    }

    // 初始化ES8311
    e_ret = es8311_init(tEs8311.hDev, &tEs8311.tClkCfg, tEs8311.eResIn, tEs8311.eResOut);
    if (e_ret != ESP_OK)
    {
        if (uPrint.tFlag.bImportant)
            log_e("bsp_es8311: Init failed: %s", esp_err_to_name(e_ret));

        tEs8311.eDevState = DS_LOST;
        return -2;
    }

    tEs8311.eDevState = DS_WORK;
    tEs8311.bInited   = true;
    if (uPrint.tFlag.bImportant)
        log_i("bsp_es8311: Init success");

    return 1;
}

/***********************************************************************************************************************
 * 函数功能    : 配置编解码器
 * 说明(备注)  : 配置时钟和分辨率
 * 传入参数    : p_clk_cfg:时钟配置
 *               e_res_in:输入分辨率
 *               e_res_out:输出分辨率
 * 输出参数    : none
 * 返回值      : 小于0:失败   大于0:成功
 ************************************************************************************************************************/
s8 cEs8311_Config(Es8311_ClockConfig_T *p_clk_cfg, Es8311_Resolution_E e_res_in, Es8311_Resolution_E e_res_out)
{
    esp_err_t e_ret;

    if (!tEs8311.bInited || tEs8311.hDev == NULL)
        return -1;

    if (p_clk_cfg == NULL)
        return -1;

    tEs8311.tClkCfg = *p_clk_cfg;
    tEs8311.eResIn  = e_res_in;
    tEs8311.eResOut = e_res_out;

    e_ret = es8311_init(tEs8311.hDev, p_clk_cfg, e_res_in, e_res_out);
    if (e_ret != ESP_OK)
        return -2;

    return 1;
}

/***********************************************************************************************************************
 * 函数功能    : 设置音量
 * 说明(备注)  : 设置输出音量
 * 传入参数    : uc_vol:音量值(0-100)
 * 输出参数    : none
 * 返回值      : 小于0:失败   大于0:成功
 ************************************************************************************************************************/
s8 cEs8311_SetVolume(u8 uc_vol)
{
    esp_err_t e_ret;
    int i_vol_set;

    if (!tEs8311.bInited || tEs8311.hDev == NULL)
        return -1;

    if (uc_vol > 100)
        uc_vol = 100;

    e_ret = es8311_voice_volume_set(tEs8311.hDev, (int)uc_vol, &i_vol_set);
    if (e_ret != ESP_OK)
        return -1;

    return 1;
}

/***********************************************************************************************************************
 * 函数功能    : 获取音量
 * 说明(备注)  : 获取当前音量
 * 传入参数    : p_vol:音量指针
 * 输出参数    : none
 * 返回值      : 小于0:失败   大于0:成功
 ************************************************************************************************************************/
s8 cEs8311_GetVolume(u8 *p_vol)
{
    esp_err_t e_ret;
    int i_vol;

    if (!tEs8311.bInited || tEs8311.hDev == NULL)
        return -1;

    if (p_vol == NULL)
        return -1;

    e_ret = es8311_voice_volume_get(tEs8311.hDev, &i_vol);
    if (e_ret != ESP_OK)
        return -2;

    *p_vol = (u8)i_vol;

    return 1;
}

/***********************************************************************************************************************
 * 函数功能    : 设置MIC增益
 * 说明(备注)  : 设置麦克风增益
 * 传入参数    : e_gain:增益值
 * 输出参数    : none
 * 返回值      : 小于0:失败   大于0:成功
 ************************************************************************************************************************/
s8 cEs8311_SetMicGain(Es8311_MicGain_E e_gain)
{
    esp_err_t e_ret;

    if (!tEs8311.bInited || tEs8311.hDev == NULL)
        return -1;

    e_ret = es8311_microphone_gain_set(tEs8311.hDev, e_gain);
    if (e_ret != ESP_OK)
        return -1;

    return 1;
}

/***********************************************************************************************************************
 * 函数功能    : 设置静音
 * 说明(备注)  : 设置静音状态
 * 传入参数    : b_mute:静音使能
 * 输出参数    : none
 * 返回值      : 小于0:失败   大于0:成功
 ************************************************************************************************************************/
s8 cEs8311_SetMute(bool b_mute)
{
    esp_err_t e_ret;

    if (!tEs8311.bInited || tEs8311.hDev == NULL)
        return -1;

    tEs8311.bMuteEn = b_mute;

    e_ret = es8311_voice_mute(tEs8311.hDev, b_mute);
    if (e_ret != ESP_OK)
        return -1;

    return 1;
}

/***********************************************************************************************************************
 * 函数功能    : 配置麦克风
 * 说明(备注)  : 配置模拟/数字麦克风
 * 传入参数    : b_digital_mic:是否使用数字麦克风
 * 输出参数    : none
 * 返回值      : 小于0:失败   大于0:成功
 ************************************************************************************************************************/
s8 cEs8311_ConfigMic(bool b_digital_mic)
{
    esp_err_t e_ret;

    if (!tEs8311.bInited || tEs8311.hDev == NULL)
        return -1;

    e_ret = es8311_microphone_config(tEs8311.hDev, b_digital_mic);
    if (e_ret != ESP_OK)
        return -1;

    return 1;
}

/***********************************************************************************************************************
 * 函数功能    : 获取ES8311设备状态
 * 说明(备注)  : 查询当前编解码芯片运行状态 (DS_INIT/DS_WORK/DS_LOST)
 * 传入参数    : none
 * 输出参数    : none
 * 返回值      : DevState_E:当前设备状态
 ************************************************************************************************************************/
DevState_E eEs8311_GetDevState(void)
{
    return tEs8311.eDevState;
}

/***********************************************************************************************************************
 * 函数功能    : 获取ES8311静音状态
 * 说明(备注)  : 查询当前是否处于静音模式
 * 传入参数    : none
 * 输出参数    : none
 * 返回值      : true:已静音  false:未静音
 ************************************************************************************************************************/
bool bEs8311_GetMute(void)
{
    return tEs8311.bMuteEn;
}

/***********************************************************************************************************************
 * 函数功能    : 获取ES8311设备句柄
 * 说明(备注)  : 提供底层驱动原生句柄供音频流等模块使用
 * 传入参数    : none
 * 输出参数    : none
 * 返回值      : es8311_handle_t:设备句柄
 ************************************************************************************************************************/
es8311_handle_t hEs8311_GetDevHandle(void)
{
    return tEs8311.hDev;
}

/***********************************************************************************************************************
 * 函数功能    : 获取ES8311输入采样分辨率
 * 说明(备注)  : 查询当前ADC输入采样位数
 * 传入参数    : none
 * 输出参数    : none
 * 返回值      : Es8311_Resolution_E:输入分辨率
 ************************************************************************************************************************/
Es8311_Resolution_E eEs8311_GetResIn(void)
{
    return tEs8311.eResIn;
}

/***********************************************************************************************************************
 * 函数功能    : 获取ES8311输出采样分辨率
 * 说明(备注)  : 查询当前DAC输出采样位数
 * 传入参数    : none
 * 输出参数    : none
 * 返回值      : Es8311_Resolution_E:输出分辨率
 ************************************************************************************************************************/
Es8311_Resolution_E eEs8311_GetResOut(void)
{
    return tEs8311.eResOut;
}

/***********************************************************************************************************************
 * 函数功能    : 获取ES8311时钟配置
 * 说明(备注)  : 查询当前时钟与采样率配置
 * 传入参数    : none
 * 输出参数    : none
 * 返回值      : const Es8311_ClockConfig_T*:时钟配置结构体指针
 ************************************************************************************************************************/
const Es8311_ClockConfig_T *ptEs8311_GetClkCfg(void)
{
    return &tEs8311.tClkCfg;
}

#endif  /* 1 */
