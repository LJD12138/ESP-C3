/*******************************************************************************************************************************
 * Project : ESP-C3
 * Module  : ESP-C3\Hardware\BSP
 * File    : bsp_qmi8658c.c
 * Date    : 2026-10-10
 * Author  : LJD(291483914@qq.com)
 * Desc    : QMI8658C 6轴IMU传感器驱动
 * -------------------------------------------------------
 * todo    :
 * 1. none
 * -------------------------------------------------------
 * Copyright (c) 2026 -inc
 *******************************************************************************************************************************/

//****************************************************Includes******************************************************************//
#include "BSP/bsp_qmi8658c.h"
#include "Print/print_task.h"

#if (1)

//****************************************************Parameter Initialization**************************************************//

static struct
{
	bool				bInited;			//是否初始化
	i2c_dev_t			tI2cDev;			//I2C设备对象
	Qmi8658c_Config_T	tConfig;			//配置参数
	Qmi8658c_Data_T		tData;				//数据
	DevState_E			eDevState;			//设备状态
}tQmi8658c;

//****************************************************Function Declaration******************************************************//
/***********************************************************************************************************************
 * 函数功能    : 接口初始化
 * 说明(备注)  : 初始化I2C接口
 * 传入参数    : none
 * 输出参数    : none
 * 返回值      : none
 ************************************************************************************************************************/
void vQmi8658c_IfaceInit(void)
{
    // 默认配置
    tQmi8658c.tConfig.mode        = QMI8658C_MODE_DUAL;
    tQmi8658c.tConfig.acc_scale   = QMI8658C_ACC_SCALE_4G;
    tQmi8658c.tConfig.acc_odr     = QMI8658C_ACC_ODR_250;
    tQmi8658c.tConfig.gyro_scale  = QMI8658C_GYRO_SCALE_512DPS;
    tQmi8658c.tConfig.gyro_odr    = QMI8658C_GYRO_ODR_250;

    tQmi8658c.eDevState = DS_INIT;
}

/***********************************************************************************************************************
 * 函数功能    : 获取QMI8658C初始化状态
 * 说明(备注)  : 查询6轴IMU芯片是否已成功初始化
 * 传入参数    : none
 * 输出参数    : none
 * 返回值      : true:已初始化  false:未初始化
 ************************************************************************************************************************/
bool bQmi8658c_IsIfaceInited(void)
{
    return tQmi8658c.bInited;
}

/***********************************************************************************************************************
 * 函数功能    : 初始化
 * 说明(备注)  : 初始化传感器
 * 传入参数    : none
 * 输出参数    : none
 * 返回值      : 小于0:失败   大于0:成功
 ************************************************************************************************************************/
s8 cQmi8658c_Init(void)
{
    esp_err_t e_ret;

    tQmi8658c.bInited = false;

    // 接口初始化
    vQmi8658c_IfaceInit();

    // 初始化I2C设备描述符 (板级共享: IO0_I2C_SDA, IO1_I2C_SCL, I2C_NUM_0)
    e_ret = qmi8658c_init_desc(&tQmi8658c.tI2cDev, QMI8658C_I2C_ADDR, I2C_NUM_0, 0, 1);
    if (e_ret != ESP_OK)
    {
        if (uPrint.tFlag.bImportant)
            log_e("bsp_qmi8658c: I2C init failed");

        tQmi8658c.eDevState = DS_LOST;
        return -1;
    }

    // 配置传感器
    e_ret = qmi8658c_setup(&tQmi8658c.tI2cDev, &tQmi8658c.tConfig);
    if (e_ret != ESP_OK)
    {
        if (uPrint.tFlag.bImportant)
            log_e("bsp_qmi8658c: Setup failed");

        tQmi8658c.eDevState = DS_LOST;
        return -2;
    }

    tQmi8658c.eDevState = DS_WORK;
    tQmi8658c.bInited   = true;
    if (uPrint.tFlag.bImportant)
        log_i("bsp_qmi8658c: Init success");

    return 1;
}

/***********************************************************************************************************************
 * 函数功能    : 配置传感器
 * 说明(备注)  : 配置量程、ODR等
 * 传入参数    : p_config:配置参数指针
 * 输出参数    : none
 * 返回值      : 小于0:失败   大于0:成功
 ************************************************************************************************************************/
s8 cQmi8658c_Config(Qmi8658c_Config_T *p_config)
{
    esp_err_t e_ret;

    if (!tQmi8658c.bInited)
        return -1;

    if (p_config == NULL)
        return -1;

    tQmi8658c.tConfig = *p_config;

    e_ret = qmi8658c_setup(&tQmi8658c.tI2cDev, p_config);
    if (e_ret != ESP_OK)
        return -2;

    return 1;
}

/***********************************************************************************************************************
 * 函数功能    : 读取数据
 * 说明(备注)  : 读取加速度计和陀螺仪数据
 * 传入参数    : p_data:数据指针
 * 输出参数    : none
 * 返回值      : 小于0:失败   大于0:成功
 ************************************************************************************************************************/
s8 cQmi8658c_ReadData(Qmi8658c_Data_T *p_data)
{
    esp_err_t e_ret;

    if (!tQmi8658c.bInited)
        return -1;

    if (p_data == NULL)
        return -1;

    e_ret = qmi8658c_read_data(&tQmi8658c.tI2cDev, p_data);
    if (e_ret != ESP_OK)
        return -2;

    // 更新全局数据
    tQmi8658c.tData = *p_data;

    return 1;
}

/***********************************************************************************************************************
 * 函数功能    : 设置加速度计量程
 * 说明(备注)  : 设置加速度计量程
 * 传入参数    : e_range:量程
 * 输出参数    : none
 * 返回值      : 小于0:失败   大于0:成功
 ************************************************************************************************************************/
s8 cQmi8658c_SetAccRange(Qmi8658c_AccRange_E e_range)
{
    if (!tQmi8658c.bInited)
        return -1;

    tQmi8658c.tConfig.acc_scale = e_range;
    return cQmi8658c_Config(&tQmi8658c.tConfig);
}

/***********************************************************************************************************************
 * 函数功能    : 设置陀螺仪量程
 * 说明(备注)  : 设置陀螺仪量程
 * 传入参数    : e_range:量程
 * 输出参数    : none
 * 返回值      : 小于0:失败   大于0:成功
 ************************************************************************************************************************/
s8 cQmi8658c_SetGyrRange(Qmi8658c_GyrRange_E e_range)
{
    if (!tQmi8658c.bInited)
        return -1;

    tQmi8658c.tConfig.gyro_scale = e_range;
    return cQmi8658c_Config(&tQmi8658c.tConfig);
}

/***********************************************************************************************************************
 * 函数功能    : 获取温度
 * 说明(备注)  : 获取当前温度值
 * 传入参数    : none
 * 输出参数    : none
 * 返回值      : 温度值(℃)
 ************************************************************************************************************************/
float fQmi8658c_GetTemp(void)
{
    Qmi8658c_Data_T tData;

    if (!tQmi8658c.bInited)
        return 0.0f;

    if (cQmi8658c_ReadData(&tData) > 0)
        return tData.temperature;

    return 0.0f;
}

/***********************************************************************************************************************
 * 函数功能    : 获取QMI8658C设备状态
 * 说明(备注)  : 查询当前IMU传感器运行状态 (DS_INIT/DS_WORK/DS_LOST)
 * 传入参数    : none
 * 输出参数    : none
 * 返回值      : DevState_E:当前设备状态
 ************************************************************************************************************************/
DevState_E eQmi8658c_GetDevState(void)
{
    return tQmi8658c.eDevState;
}

/***********************************************************************************************************************
 * 函数功能    : 获取最近一次读取的6轴数据缓存
 * 说明(备注)  : 返回最近一次读取的加速度与角速度数据指针
 * 传入参数    : none
 * 输出参数    : none
 * 返回值      : const Qmi8658c_Data_T*:数据结构体指针
 ************************************************************************************************************************/
const Qmi8658c_Data_T *ptQmi8658c_GetData(void)
{
    return &tQmi8658c.tData;
}

/***********************************************************************************************************************
 * 函数功能    : 获取当前配置参数
 * 说明(备注)  : 查询当前工作模式、量程、ODR配置
 * 传入参数    : none
 * 输出参数    : none
 * 返回值      : const Qmi8658c_Config_T*:配置结构体指针
 ************************************************************************************************************************/
const Qmi8658c_Config_T *ptQmi8658c_GetConfig(void)
{
    return &tQmi8658c.tConfig;
}

#endif  /* 1 */
